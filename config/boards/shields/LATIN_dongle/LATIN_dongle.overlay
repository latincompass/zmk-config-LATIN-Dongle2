#include <dt-bindings/zmk/matrix_transform.h>

/ {
	chosen {
		zmk,matrix_transform = &dummy_transform;
	};

	dummy_transform: keymap_transform_0 {
		compatible = "zmk,matrix-transform";
		columns = <1>;
		rows = <1>;
		map = <
			RC(0,0)
		>;
	};

    leds {
        compatible = "zmk,led-strip";
        label = "LED_STRIP";
        led-gpios = <&gpio1 13 GPIO_ACTIVE_HIGH>,  // Red (P1.13)
                    <&gpio1 14 GPIO_ACTIVE_HIGH>,  // Green (P1.14)
                    <&gpio1 15 GPIO_ACTIVE_HIGH>;  // Blue (P1.15)
        num-leds = <1>;
        color-mapping = <0 1 2>;
    };
};
