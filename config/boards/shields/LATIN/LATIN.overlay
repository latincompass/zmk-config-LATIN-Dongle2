/*
 * Copyright (c) 2022 The ZMK Contributors
 *
 * SPDX-License-Identifier: MIT
 */

#include "LATIN.dtsi"

&kscan0 {
    col-gpios
        = <&xiao_d 4 GPIO_ACTIVE_HIGH>
        , <&xiao_d 5 GPIO_ACTIVE_HIGH>
        , <&xiao_d 8 GPIO_ACTIVE_HIGH>
        , <&xiao_d 9 GPIO_ACTIVE_HIGH>
        , <&xiao_d 10 GPIO_ACTIVE_HIGH>
        ;
};

/ {
    leds {
        compatible = "zmk,led-strip";
        label = "LED_STRIP";
        led-gpios = <&gpio1 13 GPIO_ACTIVE_HIGH>,  // Red (P1.13)
                    <&gpio1 14 GPIO_ACTIVE_HIGH>,  // Green (P1.14)
                    <&gpio1 15 GPIO_ACTIVE_HIGH>;  // Blue (P1.15)
        num-leds = <1>;
        color-mapping = <0 1 2>;
    };
};
